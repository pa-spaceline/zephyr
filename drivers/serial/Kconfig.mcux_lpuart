## drivers/serial/Kconfig.mcux_lpuart
```kconfig
# Copyright 2017, 2025 NXP
# SPDX-License-Identifier: Apache-2.0

config UART_MCUX_LPUART
	bool "MCUX LPUART driver"
	default y
	depends on DT_HAS_NXP_LPUART_ENABLED
	depends on CLOCK_CONTROL
	select SERIAL_HAS_DRIVER
	select SERIAL_SUPPORT_INTERRUPT
	select PINCTRL
	help
	  Enable the MCUX LPUART driver.

if UART_MCUX_LPUART

config UART_RETRY_TIMES
	int "NXP HAL UART blocking-wait retry count"
	default 1000000
	help
	  Bounds the busy-wait loops inside NXP's MCUX HAL LPUART driver
	  (e.g. LPUART_Deinit() waiting on the Transmit Complete flag) that
	  otherwise spin forever - the HAL's own fsl_lpuart.h falls back to
	  0 when this isn't defined, and its own comment says "0 means keep
	  waiting until the flag is assert/deassert", i.e. no timeout at
	  all. Discovered via a genuine full-system hang: any driver that
	  reconfigures a LPUART's baud rate at runtime (selects
	  UART_USE_RUNTIME_CONFIGURE - e.g. GNSS_U_BLOX_M8/M10) calls
	  mcux_lpuart_configure(), which calls LPUART_Deinit(), which hung
	  forever with zero error output the moment the Transmit Complete
	  flag didn't set promptly for a GPS module that otherwise works
	  fine with other firmware on the same physical wiring - a genuine
	  driver-level missing-timeout bug, not a hardware/wiring fault.

config UART_MCUX_LPUART_ISR_SUPPORT
	bool
	default y if UART_INTERRUPT_DRIVEN || PM || UART_ASYNC_API
	help
	  Enable UART interrupt service routine.

config UART_NXP_LPUART_ASYNC_API_SUPPORT
	bool
	default y if $(dt_compat_any_has_prop,$(DT_COMPAT_NXP_LPUART),dmas)
	select SERIAL_SUPPORT_ASYNC
	select DMA if UART_ASYNC_API
	help
	  Indicates if LPUART has async api support by having dmas enabled for it

endif
```
